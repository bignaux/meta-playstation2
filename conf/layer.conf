## conf/layer.conf
```bitbake
# We have a conf and classes directory, add to BBPATH
BBPATH .= ":${LAYERDIR}"

# We have recipes-* directories, add to BBFILES
BBFILES += "${LAYERDIR}/recipes-*/*/*.bb \
            ${LAYERDIR}/recipes-*/*/*.bbappend"

BBFILE_COLLECTIONS += "meta-playstation2"
BBFILE_PATTERN_meta-playstation2 = "^${LAYERDIR}/"
BBFILE_PRIORITY_meta-playstation2 = "6"

LAYERDEPENDS_meta-playstation2 = "core"
LAYERSERIES_COMPAT_meta-playstation2 = "kirkstone"
```

## conf/machine/playstation2.conf
```bitbake
#@TYPE: Machine
#@NAME: Playstation2
#@DESCRIPTION: Machine configuration for a Playstation 2
# ref https://github.com/frno7/linux/issues/33

require tune-r5900.inc

#MACHINE_ESSENTIAL_EXTRA_RDEPENDS += "iopmod"
#MACHINE_EXTRA_RRECOMMENDS = "kernel-modules"
MACHINE_ESSENTIAL_EXTRA_RRECOMMENDS += "kernel-modules"
MACHINE_FEATURES = "ext2 ext3 serial usbgadget usbhost keyboard alsa"
# vfat : | ERROR: Feature 'cfg/fs/vfat.scc' not found, this will cause configuration failures.

#PREFERRED_PROVIDER_virtual/bootloader ?= "u-boot_playstation2"

#### KERNEL
#PREFERRED_PROVIDER_linux-libc-headers = "linux-libc-headers_5.14"

DISTRO_FEATURES = ""
QB_SYSTEM_NAME = "qemu-system-mips"

PREFERRED_PROVIDER_virtual/kernel = "linux-playstation2-dev"
KERNEL_IMAGETYPE = "vmlinuz"
#KERNEL_IMAGE_STRIP_EXTRA_SECTIONS  = ".comment"
KERNEL_ARTIFACT_BIN_EXT = ".elf"

INITRAMFS_IMAGE_BUNDLE = "1"
INITRAMFS_IMAGE = "initramfs-playstation2"

# no driver yet https://github.com/frno7/linux/issues/68
#SERIAL_CONSOLES = "38400;ttyS0"
#don't try to access tty1
#USE_VT = "0"
```

## conf/machine/tune-r5900.inc
```bitbake
# `-march=r5900' already enables the R5900 short loop workaround.
# However, the R5900 ISA and most other MIPS ISAs are mutually
# exclusive since R5900-specific instructions are generated as well.

# The `-mfix-r5900' option can be used in combination with e.g.
# `-mips2' or `-mips3' to generate generic MIPS binaries that also
# work with the R5900 target.

DEFAULTTUNE ?= "mipsr5900el"

# no fpu see https://github.com/frno7/linux/issues/3
require conf/machine/include/mips/tune-mips32r2.inc

AVAILTUNES += "mipsr5900el"
TUNEVALID[mipsr5900el] = "Enable optimization related to r5900 support"
TUNE_CCARGS .= "${@bb.utils.contains('TUNE_FEATURES', 'mipsr5900el', ' -march=r5900 ', '',d)}"

TUNE_FEATURES:tune-mipsr5900el = "${TUNE_FEATURES:tune-mipsel-nf} mipsr5900el"
BASE_LIB:tune-mipsr5900el = "lib32"
MIPSPKGSFX_VARIANT:tune-mipsr5900el = "mipsr5900el"
PACKAGE_EXTRA_ARCHS:tune-mipsr5900el = "mipsel-nf mipsr5900el-nf"

QEMU_EXTRAOPTIONS_mipsr5900el-nf = " -cpu 34kf"
```
